## bsp/levisw-mb-v1.2/Kconfig
```kconfig
menu "LeviSW-MB v1.2 BSP Configuration"

    config LEVISW_I2C_FREQ_HZ
        int "I2C-L bus frequency (Hz)"
        default 400000
        range 100000 1000000
        help
            Тактовая частота шины I2C-L (IO32=SCL0, IO33=SDA0) для TCA9535, MCP4532 и INA226.

    config LEVISW_SPI_TLE94112_FREQ_HZ
        int "TLE94112EL (D2) SPI frequency (Hz)"
        default 2000000
        range 100000 5000000
        help
            Тактовая частота SPI для драйвера единиц TLE94112EL (до 5 МГц по даташиту).

    config LEVISW_SPI_MC33879_FREQ_HZ
        int "MC33879APEKR2 (D1) SPI frequency (Hz)"
        default 2000000
        range 100000 4000000
        help
            Тактовая частота SPI для драйвера VOffset MC33879APEKR2.

    config LEVISW_DEFAULT_V1_WIPER
        int "Default MCP4532 DA2 wiper (+V1)"
        default 2
        range 0 128
        help
            Начальная уставка потенциометра DA2 (0x2C) для шины +V1 (wiper=2 соответствует ~7.8 В).

    config LEVISW_DEFAULT_V2_WIPER
        int "Default MCP4532 DA3 wiper (+V2)"
        default 10
        range 0 128
        help
            Начальная уставка потенциометра DA3 (0x2D) для шины +V2 (wiper=10 соответствует ~5.5-6.7 В).

    config LEVISW_DEFAULT_ULOAD_WIPER
        int "Default MCP4532 DA4 wiper (Uload / eLOAD)"
        default 64
        range 0 128
        help
            Начальная уставка потенциометра DA4 (0x2F) для канала eLOAD (MV1e).

endmenu
```

## examples/19_switchboard_controller/Kconfig.projbuild
```kconfig
menu "LeviSW-MB v1.2 — контроллер коммутатора"

config SWITCHBOARD_ENABLE_PHYSICAL_MATRIX
    bool "Разрешить физическое управление матрицей D/E"
    default n
    help
        По умолчанию отключено. Включайте только после физической проверки
        всех 80 точек коммутации, временных параметров, полярности, питающих
        шин и безопасных состояний драйверов. Программная симуляция остаётся
        режимом по умолчанию.

if SWITCHBOARD_ENABLE_PHYSICAL_MATRIX

config SWITCHBOARD_HARDWARE_PROFILE_APPROVED
    bool "Аппаратный профиль питания и полярности проверен"
    default n
    help
        Явное подтверждение того, что уставки MCP4532, диапазоны INA226,
        полярность активной линии E и поведение драйверов проверены на
        конкретной ревизии платы с ограничением тока источников питания.

config SWITCHBOARD_POWER_ON_AT_BOOT
    bool "Разрешить включение шин +V1 и +V2 при запуске"
    default n
    help
        Без этого параметра физическая матрица не запускается. При включении
        прошивка задаёт уставки потенциометров и включает +V1/+V2. Убедитесь,
        что источник питания ограничен по току, нагрузка отключена, а профиль
        питания подтверждён измерениями.

config SWITCHBOARD_V1_WIPER
    int "Уставка DA2 (+V1), wiper 0..128"
    range 0 128
    default 2

config SWITCHBOARD_V2_WIPER
    int "Уставка DA3 (+V2), wiper 0..128"
    range 0 128
    default 2

config SWITCHBOARD_ACTIVE_UNIT_DRIVE
    int "Полярность активного выхода E (0=не задана, 1=LOW_SIDE, 2=HIGH_SIDE)"
    range 0 2
    default 0
    help
        Значение 0 запрещает физическую сборку. Выбирайте LOW_SIDE или
        HIGH_SIDE только по схеме и результатам измерений конкретной платы.

config SWITCHBOARD_RAIL_MIN_MV
    int "Минимальное напряжение шин +V1/+V2, мВ"
    range 1000 15000
    default 6000

config SWITCHBOARD_RAIL_MAX_MV
    int "Максимальное напряжение шин +V1/+V2, мВ"
    range 1000 20000
    default 10000

endif

endmenu
```

## examples/20_switchboard_adg_tle_no_mc33879/Kconfig.projbuild
```kconfig
menu "LeviSW-MB v1.2 — ADG1608 + TLE94112 apartment matrix"

config SWITCHBOARD_ENABLE_PHYSICAL_MATRIX
    bool "Разрешить физическую матрицу ADG1608 + TLE94112"
    default n
    help
        По умолчанию используется программная симуляция.
        Физический режим разрешать только после проверки координат D/E,
        полярности E, питания, входов LU и адресной карты квартир.

if SWITCHBOARD_ENABLE_PHYSICAL_MATRIX

config SWITCHBOARD_HARDWARE_PROFILE_APPROVED
    bool "Физический профиль платы проверен"
    default n

config SWITCHBOARD_ADG_IS_D_PATH_CONFIRMED
    bool "Подтверждено: выход ADG1608 является D-координатой до квартирного жгута"
    default n
    help
        ВАЖНО: действующий аппаратный аудит схемы указывает ADG1608 S1..S8 -> AMP1..AMP8/XS3,
        а MC33879 S1..S8 -> D0..D7/XP2. Это противоречит экспериментальной модели Example 20.
        Отмечайте только после прозвонки конкретной платы/жгута и подтверждения полного пути D.

config SWITCHBOARD_MC33879_SAFE_WITH_SHARED_EN
    bool "Подтверждено безопасное состояние MC33879 при общем EN-DE=HIGH"
    default n
    help
        GPIO20 EN-DE общий для MC33879 (D1) и TLE94112 (D2). Отключение SPI MC33879
        не отключает его выводы, когда EN-DE поднимается для TLE. Отмечайте только если
        MC33879 физически отсутствует/изолирован либо измерениями подтверждено безопасное
        состояние его выходов и цепи VOffset при EN-DE=HIGH без SPI-команд.

config SWITCHBOARD_POWER_ON_AT_BOOT
    bool "Разрешить включение шин +V1/+V2 при старте"
    default n
    help
        Задаёт DA2/DA3, включает +V1/+V2 и проверяет PGOOD/INA226.
        Абонентский жгут должен быть отключён во время первичной проверки.

config SWITCHBOARD_ACTIVE_UNIT_DRIVE
    int "Полярность активного E-выхода (0=не задана, 1=LOW_SIDE, 2=HIGH_SIDE)"
    range 0 2
    default 0
    help
        Нельзя включать физическую матрицу, пока режим не подтверждён схемой
        и измерениями безопасной нагрузкой.

config SWITCHBOARD_V1_WIPER
    int "Уставка DA2 (+V1), wiper 0..128"
    range 0 128
    default 2

config SWITCHBOARD_V2_WIPER
    int "Уставка DA3 (+V2), wiper 0..128"
    range 0 128
    default 10

config SWITCHBOARD_RAIL_MIN_MV
    int "Минимальное напряжение +V1/+V2, мВ"
    range 1000 15000
    default 5500

config SWITCHBOARD_RAIL_MAX_MV
    int "Максимальное напряжение +V1/+V2, мВ"
    range 1000 20000
    default 10000

endif

config SWITCHBOARD_ENABLE_DAC_RING
    bool "Генерировать низкоуровневый тон вызова на SOUND1/SOUND2"
    default n
    help
        Это аудиотон на DAC GPIO25/GPIO26 через XS2:4/6.
        Это НЕ генератор высоковольтного переменного напряжения звонка
        для аналоговой трубки. До включения проверьте вход внешнего LeviAMP.

config SWITCHBOARD_RING_TONE_HZ
    int "Частота тестового тона, Гц"
    range 130 3000
    default 425

config SWITCHBOARD_RING_AMP_MASK
    int "Разрешить каналы внешнего усилителя (бит0=AMP1, бит1=AMP2, бит2=AMP3)"
    range 0 7
    default 0
    help
        0 — не включать ENAMP1..3. Выберите канал только после проверки схемы LeviAMP.

config SWITCHBOARD_RING_ON_MS
    int "Длительность сигнала вызова, мс"
    range 100 10000
    default 1000

config SWITCHBOARD_RING_OFF_MS
    int "Пауза между сигналами вызова, мс"
    range 100 30000
    default 4000

config SWITCHBOARD_ALARM_MONITOR_ENABLE
    bool "Опрос входа ALARM-IN внешнего усилителя"
    default y

config SWITCHBOARD_ALARM_FAULT_ENABLE
    bool "Переводить контроллер в FAULT при активном ALARM-IN"
    depends on SWITCHBOARD_ALARM_MONITOR_ENABLE
    default n
    help
        Полярность входа внешнего модуля должна быть измерена.
        Пока не подтверждена, оставьте аварийную интерпретацию выключенной.

config SWITCHBOARD_ALARM_ACTIVE_HIGH
    bool "ALARM-IN активен уровнем HIGH"
    depends on SWITCHBOARD_ALARM_FAULT_ENABLE
    default y

endmenu
```
